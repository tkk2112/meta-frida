## conf/layer.conf
```bitbake
# SPDX-License-Identifier: MIT

BBPATH .= ":${LAYERDIR}"

BBFILES += "${LAYERDIR}/recipes-*/*/*.bb \
            ${LAYERDIR}/recipes-*/*/*.bbappend"

BBFILE_COLLECTIONS += "frida"
BBFILE_PATTERN_frida = "^${LAYERDIR}/"
BBFILE_PRIORITY_frida = "6"

LAYERDEPENDS_frida = "core"
LAYERSERIES_COMPAT_frida = "wrynose"
```
